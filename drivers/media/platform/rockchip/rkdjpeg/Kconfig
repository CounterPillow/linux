## drivers/media/platform/rockchip/rkdjpeg/Kconfig
```kconfig
# SPDX-License-Identifier: GPL-2.0
config VIDEO_RKDJPEG
	tristate "Rockchip rkdjpeg JPEG decoder driver"
	depends on ARCH_ROCKCHIP || COMPILE_TEST
	depends on VIDEO_DEV
	select MEDIA_CONTROLLER
	select MEDIA_CONTROLLER_REQUEST_API
	select VIDEOBUF2_DMA_CONTIG
	select VIDEOBUF2_VMALLOC
	select V4L2_MEM2MEM_DEV
	help
	  Support for the JPEG decoder found on Rockchip SoCs such as the
	  RK3566, RK3568 and RK3588.
	  To compile this driver as a module, choose M here: the module
	  will be called rkdjpeg.
```
